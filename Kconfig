## Kconfig
```kconfig
# Main menu title
mainmenu "LunSystem Build Menu"

# Sub Menu For Howling OS Assets
config HOWLINGOS_ENABLE
    bool "Howling OS"
    default n
    help
        This enables the Howling code to be compiled
        Note this is meant for ONLY HOWLING OS SYSTEMS.

menu "Howling OS"
    depends on HOWLINGOS_ENABLE
    
    config HOWLING_INSTALL_COMPILE
        bool "Howling Install"
        default n
        help
            This enables the Howling Install code to be compiled
            Note this is meant for ONLY HOWLING OS SYSTEMS.

    config HOWLING_COMPILE
        bool "Howling (Package Manager)"
        default n
        help
            This enables the Howling code to be compiled
            Note this is meant for ONLY HOWLING OS SYSTEMS.

    config CONFIG_COMPILE_TARGET_HOWLING_RECOVERY
        bool "Compile Howling OS Recovery Image"
        default n
        help
            This compiles a image that HowlingOS can use for recovery.

    config LUNPACKAGE_ENABLE
        bool "Make a LunPackage for installing software, and libs"
        default n
        help
            This allows the user to make a bundle for installing many different types of software and libs for Howling OS.
    
    menu "Select Packages For LunPackage"
        depends on LUNPACKAGE_ENABLE

        config PY_SPACEINFO_COMPILE
            bool "SpaceInfo"
            default n
            help
                Service for checking for low space.
    endmenu
endmenu

# Sub Menu For LunSystem Software.
menu "LunSystem Software"
    config LTT_COMPILE_ENABLE
        bool "LTT (LunTool Terminal)"
        default n
        help
            This enables the LTT code to be compiled
endmenu

# Sub Menu For LunSystem Libaries.
menu "LunSystem Libaries"
    config LIB_HOWLING_COMPILE
        bool "Howling (Libary)"
        default n
        help
            This enables the libHowling code to be compiled
            Note this is meant for ONLY HOWLING OS SYSTEMS.

    config LIB_LUNTOOL_COMPILE
        bool "LunTool (Libary)"
        default n
        help
            This enables the libLunTool code to be compiled.
endmenu

# Sub Menu For Target Options.
menu "Target Options"
    config COMPILE_INTO_LUNPACK
        bool "Compile LunPack"
        default n
        help
            This after compling the selected assets will package them into a LunPack Asset.

    config COMPILE_TARGET_WINDOWS
        bool "Compile For Windows"
        default n
        help
            This compiles the selected software and libraries for Windows
    
    config COMPILE_TARGET_LINUX
        bool "Compile For Linux"
        default y
        help
            This compiles the selected software and libraries for Linux

    config COMPILE_TARGET_HOWLING
        bool "Compile For HowlingOS"
        default n
        help
            This compiles the selected software and libraries for Linux
endmenu
```
